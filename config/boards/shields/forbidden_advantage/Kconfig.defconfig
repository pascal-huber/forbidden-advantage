## config/boards/shields/forbidden_advantage/Kconfig.defconfig
```kconfig
if SHIELD_FORBIDDEN_ADVANTAGE

config ZMK_KEYBOARD_NAME
    default "Forbidden Advantage"

endif
```

## config/boards/shields/forbidden_advantage/Kconfig.shield
```kconfig
config SHIELD_FORBIDDEN_ADVANTAGE
    def_bool $(shields_list_contains,forbidden_advantage)
```
